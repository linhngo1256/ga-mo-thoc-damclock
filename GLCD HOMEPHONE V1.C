#include<regx52.h>
#include <INTRINS.H>

#define uchar unsigned char 
#define CS	P2_3 //Chon chip
#define SDA	P2_2 //Data SPI
#define AO	P2_1 //Chot du lieu Command va Data (C/D)
#define SCK	P2_0 //Clock SPI

sbit sda =	P3^1;
sbit scl =	P3^0;
sbit menu_key=P3^7;
sbit up_key=P3^6;
sbit down_key=P3^5;
sbit DQ = P1^0; 
uchar temp1,temp2,temp; 

unsigned char gio,phut,giay,thang_al,ngay_al,mode = 0;
unsigned char time[7];

unsigned char code font[][8] ={ 
    {0x00,0x00,0x00,0x00,0x00,0x00,0x00,0x00},  // ' '
    {0x00,0x00,0x00,0x00,0x00,0x00,0x00,0x00},  // '!'
    {0x00,0x00,0x00,0x00,0x00,0x00,0x00,0x00},  // '"'
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		{0x00,0x00,0x00,0x00,0x00,0x00,0x00,0x00},   // <-
};

unsigned char code font_big_1[][8] ={	 
    {0x00,0x00,0x00,0x00,0x00,0x00,0x00,0x00},   
    {0x00,0x00,0x00,0x00,0x00,0x00,0x00,0x00},   
    {0x00,0x00,0x00,0x00,0x00,0x00,0x00,0x00},   
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    {0x00,0x00,0x00,0x00,0x00,0x18,0x3C,0x3C}  
};	
///////////////////////////////////////////////////////////////////////
unsigned char code font_big_2[][8] ={	 
    {0x00,0x00,0x00,0x00,0x00,0x00,0x00,0x00},   
    {0x00,0x00,0x00,0x00,0x00,0x00,0x00,0x00},   
    {0x00,0x00,0x00,0x00,0x00,0x00,0x00,0x00},   
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    {0x3C,0x3C,0x18,0x00,0x00,0x00,0x00,0x00}  
}; 
unsigned char code font_big_3[][8] ={   
    {0x00,0x00,0x00,0x00,0x00,0x00,0x00,0x00},   
    {0x00,0x00,0x00,0x00,0x00,0x00,0x00,0x00},   
    {0x00,0x00,0x00,0x00,0x00,0x00,0x00,0x00},   
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    {0x00,0x00,0x00,0x00,0x00,0x18,0x3C,0x3C}  
}; 
unsigned char code font_big_4[][8] ={	   
    {0x00,0x00,0x00,0x00,0x00,0x00,0x00,0x00},   
    {0x00,0x00,0x00,0x00,0x00,0x00,0x00,0x00},   
    {0x00,0x00,0x00,0x00,0x00,0x00,0x00,0x00},   
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    {0x3C,0x3C,0x18,0x00,0x00,0x00,0x00,0x00}  
};
const unsigned char code lich[]={ 
0x1b,0x0c//1999 
,0x11,0x12,0x03,0x04,0x15,0x06,0x07,0x18,0x09,0x1a,0x1b,0x0c                      
,0x11,0x12,0x03,0x14,0x04,0x15,0x06,0x07,0x18,0x09,0x1a,0x0b,0x1c                 
,0x11,0x12,0x03,0x14,0x05,0x16,0x07,0x08,0x19,0x0a,0x1b,0x0c                      
,0x11,0x12,0x03,0x14,0x15,0x06,0x17,0x08,0x09,0x1a,0x0b,0x1c                      
,0x01,0x12,0x02,0x13,0x14,0x05,0x16,0x07,0x18,0x09,0x1a,0x0b,0x1c                 
,0x01,0x12,0x03,0x14,0x05,0x16,0x17,0x08,0x19,0x0a,0x1b,0x0c//2005                
,0x11,0x02,0x13,0x04,0x05,0x16,0x17,0x07,0x18,0x19,0x0a,0x1b,0x0c //2006         
,0x11,0x02,0x13,0x04,0x05,0x16,0x07,0x18,0x19,0x1a,0x0b,0x1c                      
,0x11,0x02,0x03,0x14,0x05,0x06,0x17,0x08,0x19,0x0a,0x1b,0x1c                     
,0x11,0x12,0x03,0x04,0x15,0x05,0x06,0x17,0x08,0x19,0x0a,0x1b,0x1c  
,0x11,0x02,0x13,0x04,0x15,0x06,0x07,0x18,0x09,0x1A,0x0B,0x1C///2010 
,0x11,0x02,0x13,0x14,0x05,0x16,0x07,0x08,0x19,0x0A,0x1B,0x0C       
,0x11,0x02,0x13,0x14,0x04,0x15,0x06,0x17,0x08,0x19,0x0a,0x1b,0x0c      
,0x11,0x02,0x13,0x04,0x15,0x16,0x07,0x18,0x09,0x1a,0x0b,0x1c              
,0x01,0x12,0x03,0x14,0x05,0x16,0x07,0x18,0x19,0x09,0x1a,0x0b,0x1c            
,0x01,0x12,0x03,0x04,0x15,0x06,0x17,0x18,0x19,0x0a,0x1b,0x0c                  
,0x11,0x02,0x13,0x04,0x05,0x16,0x07,0x18,0x19,0x0a,0x1b,0x1c                    
,0x01,0x12,0x03,0x14,0x05,0x06,0x16,0x07,0x18,0x09,0x1a,0x1b,0x1c//2017          
,0x01,0x12,0x03,0x14,0x05,0x06,0x17,0x08,0x19,0x0a,0x1b,0x1c                      
,0x11,0x02,0x13,0x04,0x15,0x06,0x07,0x18,0x09,0x0a,0x1b,0x1c                      
,0x01,0x12,0x13,0x14,0x04,0x15,0x06,0x07,0x18,0x09,0x1a,0x0b,0x1c
};
const unsigned int code count_year1[]={
  0,59,413,797,1151,1506,1890,2244,
	2628,2983,3337,3721,4075,4429,4813,
	5168,5552,5906,6261,6645,6999,7353,
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  34403,34758,35112,35496,35850,36204,36588};
const unsigned int code count_year[]={
  25 ,391 ,756 ,1121 ,1486 ,1852 ,2217 ,
	2582 ,2947 ,3313 ,3678 ,4043 ,4408 ,
	4774 ,5139 ,5504 ,5869 ,6235 ,6600 ,
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	34724 ,35089 ,35455 ,35820 ,36185 ,36550
};
const unsigned int code sothang[]={
	0,2,14,27,39,51,64,76,89,101,113,
	126,138,150,163,175,188,200,212,
	225,237,249,262,274,286,299,311,
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 1189,1202,1214,1226,1239
};
const unsigned int code count_month[] ={0,0,31,59,90,120,151,181,212,243,273,304,334}; 
const unsigned int code count_month1[]={0,0,31,60,91,121,152,182,213,244,274,305,335};
const unsigned int code nd[]={
	500,485,470,450,430,405,394,384,
	368,352,342,332,322,315,308,300,
	292,286,275,268,262,256,246,236,
	226,216,212,202,188,180,172,165,
  156,150,145,140,138,135,130,125,
  120,115,110,105,100,98,97,93,90,85
};
 
unsigned char hex_dec(unsigned char hex){ 
	return((hex>>4)*10 +(hex & 0xf));} 
unsigned char dec_hex(unsigned char dec){  
	return(((dec/10) <<4 )+(dec%10));} 
unsigned int tinhlich(unsigned char ngayduong,thangduong,nam)
{
	unsigned int songay,t5;
	unsigned char ngayam,thangam;
	ngayduong 	= hex_dec(ngayduong);
	thangduong 	= hex_dec(thangduong);
	nam 		= hex_dec(nam);
if(nam%4==0) songay=count_year[nam]+count_month1[thangduong]+ngayduong;
else songay=count_year[nam]+count_month[thangduong]+ngayduong; 
songay--; 
songay=songay-count_year1[nam]; 

for(t5=sothang[nam];t5<262;t5++) 
{
	if(songay==0)break;
 	if(songay>50000)break;

 	if(lich[t5]>16) { songay=songay-30;}
	else            { songay=songay-29;}
}
    if(songay==0) { if(lich[t5-1]>16) { thangam=lich[t5-1]-16; ngayam=30; }
                    else              { thangam=lich[t5-1];    ngayam=29; } }
  else            { if(lich[t5-1]>16) { thangam=lich[t5-1]-16; ngayam=songay+30; }
	                  else              { thangam=lich[t5-1];    ngayam=songay+29; } }

 	ngayam 	= dec_hex(ngayam);
	thangam = dec_hex(thangam);
	t5= thangam << 8  ;
	t5 = t5 + ngayam;
	return(t5);
}
///////////////////////////////////////////////////////  
void delay(unsigned int i)
 { unsigned int j;
 while(i-->0)
 {   
 for(j=0;j<400;j++)
 {
 }
 }
 } 
 void delay_ms(unsigned int t)
 {
 unsigned int x,y;
 for(x=0; x<t; x++);
 {
 for(y=0; y<123; y++);   //delay 1ms
 }
 }
 void delay_lcd(unsigned int t){
 unsigned int i;
 unsigned char j;
 for(i=0;i<t;i++)
 for(j=0;j<125;j++);
 } 
 void delay_18B20(unsigned int i)
 {
 while(i--);
 } 
 void lcd_write(unsigned char cd, unsigned char byte){ 
	unsigned char h;
	CS=0;
	if(cd)AO=1; 
	else AO=0; 
	for(h=0;h<8;h++){
		if(!(byte&0x80))SDA=0; 
		else SDA=1;
		SCK=0;
		SCK=1;
		byte<<=1;
	}
	AO=~AO;
	CS=1;
} 
void lcd_gotoxy(unsigned char x, unsigned char y) 
{
	x=x*8; 
	lcd_write(0,(x & 0x0f));
	lcd_write(0,((x >> 4) & 0x07)|0x10);
	lcd_write(0,(y & 0x0f)|0xb0);
} 
void lcd_putchar16_1(char dat) 
{
	unsigned char v;
	if((dat >= 0x20) && (dat <= 0x3a)){
		dat=dat-32;
		for(v=0;v<8;v++)
			lcd_write(1, font_big_1[dat][v]);
	}
} 
void lcd_putchar16_2(char dat) 
{
	unsigned char v;
	if((dat >= 0x20) && (dat <= 0x3a)){
		dat=dat-32;
		for(v=0;v<8;v++)
			lcd_write(1, font_big_2[dat][v]);
	}
} 
void lcd_putchar16_3(char dat) 
{
	unsigned char v;
	if((dat >= 0x20) && (dat <= 0x3a)){
		dat=dat-32;
		for(v=0;v<8;v++)
			lcd_write(1, font_big_3[dat][v]);
	}
} 
void lcd_putchar16_4(char dat) 
{
	unsigned char v;
	if((dat >= 0x20) && (dat <= 0x3a)){
		dat=dat-32;
		for(v=0;v<8;v++)
			lcd_write(1, font_big_4[dat][v]);
	}
} 
void lcd_puts_4(char *s) 
{
	while(*s)
		lcd_putchar16_4(*s++);
} 
void lcd_clear() 
{
	unsigned char u,w;
	for(u=0;u<8;u++){
		lcd_gotoxy(0,u);
		for(w=0;w<130;w++)
			lcd_write(1,0);
	}
	lcd_gotoxy(0,0);
} 
void lcd_putchar(char dat) 
{
	unsigned char v;
	if((dat >= 0x20) && (dat <= 0x7f)){
		dat=dat-32;
		for(v=0;v<8;v++)
			lcd_write(1, font[dat][v]);
	}
} 
void lcd_putchar_amban(char dat) 
{
	unsigned char v;
	if((dat >= 0x20) && (dat <= 0x7f)){
		dat=dat-32;
		for(v=0;v<8;v++)
			lcd_write(1, ~font[dat][v]);
	}
}
void lcd_puts_amban(char *s) 
{
	while(*s)
		lcd_putchar_amban(*s++);
} 
void lcd_puts(char *s) 
{
	while(*s)
		lcd_putchar(*s++);
} 
void lcd_init() 
{
	lcd_write(0,0xE2); //Reset
	delay_lcd(100);	   //Delay 100ms
	lcd_write(0,0xAF); //Display ON, 0xAE - OFF
	lcd_write(0,0x2F); //Power control	
	lcd_clear(); //Xoa man hinh
}
void Init_DS18B20(void) 
{
	 unsigned char x=0;
	 DQ = 1;          //DQ reset
	 delay_18B20(8);  //Slight delay
	 DQ = 0;          //SCM will be pulled down DQ
	 delay_18B20(80); //Accurate delay Greater than 480us
	 DQ = 1;          //Pulled the bus
	 delay_18B20(14);
	 x=DQ;            //After slight delay is initialized if x = 0 x = 1 is initialized successfully defeat
	 delay_18B20(20);
} 
unsigned char ReadOneChar(void)
{
	uchar i=0;
	uchar dat = 0;
	for (i=8;i>0;i--)
	 {
		  DQ = 0; // To the pulse signal
		  dat>>=1;
		  DQ = 1; // To the pulse signal
		  if(DQ)
		  dat|=0x80;
		  delay_18B20(4);
	 }
 	return(dat);
} 
void WriteOneChar(uchar dat)
{
 	unsigned char i=0;
 	for (i=8; i>0; i--)
 	{
  		DQ = 0;
 		DQ = dat&0x01;
    	delay_18B20(5);
 		DQ = 1;
    	dat>>=1;
 }
}
 
void ReadTemperature(void)
{
	unsigned char a=0;
	unsigned char b=0;
	unsigned char t=0;

	Init_DS18B20();
	WriteOneChar(0xCC);    	// Skip read serial number column number of operations
	WriteOneChar(0x44); 	// Start temperature conversion

	delay_18B20(100);       // this message is wery important

	Init_DS18B20();
	WriteOneChar(0xCC); 	//Skip read serial number column number of operations
	WriteOneChar(0xBE); 	//Read the temperature register, etc. (a total of 9 registers readable) is the temperature of the first two

	delay_18B20(100);

	a=ReadOneChar();    	//Read the low temperature
	b=ReadOneChar();   		//Read the high temperature
	temp1=b<<4;
	temp1+=(a&0xf0)>>4;
	temp2=a&0x0f;
  temp=((b*256+a)>>4);    //In addition to the current collection temperature of 16 was the actual temperature
}
//////////////////////////////////////////////////////
 void start(void) 
 {				
 scl=1;
 sda=1;	
 _nop_();
 _nop_();
 sda=0;
 _nop_();
 scl=0;
 }
 void stop(void)	
 {	 
 scl=0;
 _nop_();
 sda=0;
 _nop_();
 scl=1;
 _nop_();
 sda=1;
 }
 bit write(unsigned char x)
 {	
 unsigned char i;
 bit k;	
 for(i=0;i<8;i++)
 {
 sda=(x&0x80);
 scl=1;					  
 _nop_();
 _nop_();			  
 scl=0;
 x<<=1;
 }
 sda=1;
 scl=1;
 _nop_();
 _nop_();
 k=sda ;
 scl=0;
 _nop_();	 
 return k ;
 }
 unsigned char read(bit ack)
 {	
 unsigned char Data,i;
 sda=1;	
 for(i=0;i<8;i++)
 {
 scl=1; 
 Data<<=1;
 Data=Data|sda;
 scl=0;
 }
 scl =0;	 	
 sda=ack;
 scl=1; 
 _nop_();
 _nop_();
 scl=0;
 _nop_();
 sda = 1;
 scl = 1;
 return Data;
 }
 void read_ds(void)
 {		
 int i;
 start();
 write(0xd0);
 write(0x00);
 start();
 write(0xd1);
 for(i=0;i<6;i++)
 time[i] = read(0);	
 time[6] = read(1);
 stop(); 	  
 }
 void write_ds(void)
 {
 unsigned char t;
 start();
 write(0xd0);
 write(0x0);
 for(t=0;t<7;t++)
 write(time[t]);
 stop();
 }
 void am_lich (bit k)
 {	
 unsigned int t;
 if((time[2]==0 & time[1] ==0 & time[0] < 3) | (k==1) ) //Tinh lich 00h00p03s
 {
 t = tinhlich(time[4],time[5],time[6]);			
 ngay_al=t & 0xff;
 thang_al= t >> 8;	
 };		
 }
 unsigned char tang(unsigned char bcd,unsigned char min,unsigned char max)
 {	
 if(bcd>=max) bcd = min;
 else if ((bcd& 0xf)==9)  bcd = bcd + 0x10 - 0x9;   
 else bcd++;
 return bcd;
 }
 unsigned char giam(unsigned char bcd,unsigned char min,unsigned char max)
 {
 if(bcd<=min) bcd = max;
 else if ((bcd& 0xf)==0)  bcd = bcd - 0x10 + 0x9; 	    
 else bcd--;
 return bcd;
 }
void scan_key (void)
{
 static unsigned char l;
 if(menu_key==0)
 {
 delay(10);
 if(menu_key==0)
 {
 while(menu_key==0 & l < 20){ l++; delay(10);};
 delay(10);
 if(l<20)
 {
 mode++;
 if( mode  > 7 )
 {
 mode = 0;
 write_ds(); 
 am_lich (1);
 }
 }
 if(l>=20)
 {
 mode = 0; 
 am_lich (1);
 }
	}
  }
 else if(up_key==0)
 {
 delay(10);
 if(up_key==0)
 {
 while(up_key==0 & l < 20){ l++; delay(10);};
 delay(10);
 if(l>=20) 
 {
 if	   (mode ==1 ) time[0] = tang(time[0],0   ,0x59);
 else if(mode ==2 ) time[1] = tang(time[1],0   ,0x59);
 else if(mode ==3 ) time[2] = tang(time[2],0   ,0x23);
 else if(mode ==4 ) time[3] = tang(time[3],0x1 ,0x07);
 else if(mode ==5 ) time[4] = tang(time[4],1   ,0x31);
 else if(mode ==6 ) time[5] = tang(time[5],1   ,0x12);
 else if(mode ==7 ) time[6] = tang(time[6],0x1 ,0x20);
 }	
 if(l<20)
 {
 if	   (mode ==1 ) time[0] = tang(time[0],0   ,0x59);
 else if(mode ==2 ) time[1] = tang(time[1],0   ,0x59);
 else if(mode ==3 ) time[2] = tang(time[2],0   ,0x23);
 else if(mode ==4 ) time[3] = tang(time[3],0x1 ,0x07);
 else if(mode ==5 ) time[4] = tang(time[4],1   ,0x31);
 else if(mode ==6 ) time[5] = tang(time[5],1   ,0x12);
 else if(mode ==7 ) time[6] = tang(time[6],0x1 ,0x20);
 }	
 }
 }	
 else if(down_key==0)
 {
 delay(10);
 if(down_key==0)
 {
 while(down_key==0 & l < 20){ l++; delay(10);};
 delay(10);
 if(l>=20)
 {
 if	   (mode ==1 ) time[0] = giam(time[0],0   ,0x59); 
 else if(mode ==2 ) time[1] = giam(time[1],0   ,0x59); 
 else if(mode ==3 ) time[2] = giam(time[2],0   ,0x23); 
 else if(mode ==4 ) time[3] = giam(time[3],0x1 ,0x07); 
 else if(mode ==5 ) time[4] = giam(time[4],1   ,0x31); 
 else if(mode ==6 ) time[5] = giam(time[5],1   ,0x12); 
 else if(mode ==7 ) time[6] = giam(time[6],0x1 ,0x20); 
 }	
 if(l<20)
 {
 if	   (mode ==1 ) time[0] = giam(time[0],0   ,0x59); 
 else if(mode ==2 ) time[1] = giam(time[1],0   ,0x59); 
 else if(mode ==3 ) time[2] = giam(time[2],0   ,0x23); 
 else if(mode ==4 ) time[3] = giam(time[3],0x1 ,0x07); 
 else if(mode ==5 ) time[4] = giam(time[4],1   ,0x31); 
 else if(mode ==6 ) time[5] = giam(time[5],1   ,0x12); 
 else if(mode ==7 ) time[6] = giam(time[6],0x1 ,0x20); 
 }	
 }
 }
 else l = 0;		
 }
 void kiem_tra_ds (void)
 { 
 read_ds();
 if(time[0] & 0x80)
 {
 time[0] = 0x1;
 time[1] = 0x40;
 time[2] = 0x6;
 time[3] = 0x3;
 time[4] = 0x1;
 time[5] = 0x12;
 time[6] = 0x15;
 write_ds(); 
 }
 }
 void main()
 {	
 kiem_tra_ds();
 am_lich (1);
 delay_ms(500);
 lcd_init();
 delay_ms(100);
 lcd_clear();
 delay_ms(300);
 while(1){
 if(mode ==0)
 {
 read_ds();
 ReadTemperature(); 
 am_lich (0);
 }
 lcd_gotoxy(0,0); lcd_puts_amban("  DAM CLOCK V1  ");	
 lcd_gotoxy(0,1); lcd_putchar16_1(((time[2]%100)>> 4)+48); lcd_putchar16_2(((time[2]%100)>> 4)+48);
 lcd_putchar16_1((time[2]& 0xf)+48); 
 lcd_putchar16_2((time[2]& 0xf)+48); 
 lcd_putchar16_1(':');	 
 lcd_putchar16_2(':');
 lcd_putchar16_1(((time[1]%100)>> 4)+48); 
 lcd_putchar16_2(((time[1]%100)>> 4)+48); 
 lcd_putchar16_1((time[1]& 0xf)+48); 
 lcd_putchar16_2((time[1]& 0xf)+48); 
 lcd_putchar16_1(':');	 
 lcd_putchar16_2(':');
 lcd_putchar16_1(((time[0]%100)>> 4)+48); 
 lcd_putchar16_2(((time[0]%100)>> 4)+48); 
 lcd_putchar16_1((time[0]& 0xf)+48); 
 lcd_putchar16_2((time[0]& 0xf)+48);
 lcd_gotoxy(0,2); 
 lcd_putchar16_3(((time[2]%100)>> 4)+48); 
 lcd_putchar16_4(((time[2]%100)>> 4)+48); 
 lcd_putchar16_3((time[2]& 0xf)+48); 
 lcd_putchar16_4((time[2]& 0xf)+48); 
 lcd_putchar16_3(':');		 
 lcd_putchar16_4(':');	
 lcd_putchar16_3(((time[1]%100)>> 4)+48); 
 lcd_putchar16_4(((time[1]%100)>> 4)+48); 
 lcd_putchar16_3((time[1]& 0xf)+48); 
 lcd_putchar16_4((time[1]& 0xf)+48); 
 lcd_putchar16_3(':'); 
 lcd_putchar16_4(':');
 lcd_putchar16_3(((time[0]%100)>> 4)+48);  
 lcd_putchar16_4(((time[0]%100)>> 4)+48); 
 lcd_putchar16_3((time[0]& 0xf)+48); 
 lcd_putchar16_4((time[0]& 0xf)+48);
 lcd_gotoxy(0,4); 
 lcd_puts_amban(" 20");
 lcd_gotoxy(3,4); 
 lcd_putchar_amban(((time[6]%100)>> 4)+48); 
 lcd_putchar_amban((time[6]& 0xf)+48);
 lcd_gotoxy(5,4); 
 lcd_puts_amban(" ");
 lcd_gotoxy(10,4); 
 lcd_puts_amban("  AL  ");
 lcd_gotoxy(6,4); if(time[3]==0x01) { lcd_putchar16_1('.');} else { lcd_putchar16_1(',');}
 lcd_gotoxy(7,4); if(time[3]==0x01) { lcd_putchar16_2('.');} else { lcd_putchar16_2(',');}
 lcd_gotoxy(6,5); if(time[3]==0x01) { lcd_putchar16_3('.');} else { lcd_putchar16_3(',');}
 lcd_gotoxy(7,5); if(time[3]==0x01) { lcd_putchar16_4('.');} else { lcd_putchar16_4(',');}
 lcd_gotoxy(8,4); if(time[3]==0x01) { lcd_putchar16_1('-');} else { lcd_putchar16_1((time[3]& 0xf)+48);}	 
 lcd_gotoxy(9,4); if(time[3]==0x01) { lcd_putchar16_2('-');} else { lcd_putchar16_2((time[3]& 0xf)+48);}		 
 lcd_gotoxy(8,5); if(time[3]==0x01) { lcd_putchar16_3('-');} else { lcd_putchar16_3((time[3]& 0xf)+48);}	 
 lcd_gotoxy(9,5); if(time[3]==0x01) { lcd_putchar16_4('-');} else { lcd_putchar16_4((time[3]& 0xf)+48);}
 lcd_gotoxy(0,5); 
 lcd_putchar(((time[4]%100)>> 4)+48); lcd_putchar((time[4]& 0xf)+48); lcd_putchar('/');
 lcd_gotoxy(3,5); 
 lcd_putchar(((time[5]%100)>> 4)+48); lcd_putchar((time[5]& 0xf)+48);
 lcd_gotoxy(11,5); 
 lcd_putchar(((ngay_al%100)>> 4)+48); lcd_putchar((ngay_al& 0xf)+48); lcd_putchar('/');
 lcd_gotoxy(14,5); 
 lcd_putchar((( thang_al%100)>> 4)+48); lcd_putchar(( thang_al& 0xf)+48);
 lcd_gotoxy(0,6); 
 lcd_puts_4("++++++++++++++++");
 if ( mode == 0) { lcd_gotoxy(3,7); lcd_puts_4("*)(");	 lcd_gotoxy(7,7); lcd_putchar(((temp1%100)/10)+48);  lcd_putchar((temp1%10)+48); lcd_putchar(','); lcd_putchar(((temp2%100)/10)+48); lcd_puts("*C    ");	 }
 else if ( mode == 1) {   
lcd_gotoxy(3,7); lcd_puts("SET Giay  ");}
 else if ( mode == 2) {   
lcd_gotoxy(3,7); lcd_puts("SET Phut  ");}
 else if ( mode == 3) {   
lcd_gotoxy(3,7); lcd_puts("SET Gio   ");}
 else if ( mode == 4) {   
lcd_gotoxy(3,7); lcd_puts("SET Thu   ");}
 else if ( mode == 5) {   
lcd_gotoxy(3,7); lcd_puts("SET Ngay  "); am_lich (1);}
 else if ( mode == 6) {   
lcd_gotoxy(3,7); lcd_puts("SET Thang "); am_lich (1);}
 else if ( mode == 7) {   
lcd_gotoxy(3,7); lcd_puts("SET Nam   "); am_lich (1);}  
 delay_ms(200);
 scan_key(); 
 } 
 }